## ti_sk_sm62x_secure_yocto/conf/bblayers.conf
```bitbake
# LAYER_CONF_VERSION is increased each time build/conf/bblayers.conf
# changes incompatibly
LCONF_VERSION = "7"

BBPATH = "${TOPDIR}"
BBFILES ?= ""

BBLAYERS ?= " \
  /big/yocto_am62xx_secboot/upstream_layers/openembedded-core/meta \
  /big/yocto_am62xx_secboot/upstream_layers/meta-arm/meta-arm-toolchain \
  /big/yocto_am62xx_secboot/upstream_layers/meta-arm/meta-arm \
  /big/yocto_am62xx_secboot/upstream_layers/meta-ti/meta-ti-bsp \
  /big/yocto_am62xx_secboot/upstream_layers/meta-ti/meta-ti-extras \
  /big/yocto_am62xx_secboot/myprj_layers/meta-bsp \
  /big/yocto_am62xx_secboot/build_am62xx/workspace \
  "
#  /big/yocto_am62xx_secboot/build_am62xx/workspace 
#  "
```
